## sdkconfig.defaults
```kconfig
# Enable FATFS read only with long filename support
# for loading Cert/CA/etc from filesystem
# (if enabled in config)
CONFIG_FATFS_READONLY=y
CONFIG_FATFS_CODEPAGE_437=y
CONFIG_FATFS_LFN_HEAP=y

# Enable TLS asymmetric in/out content length
CONFIG_MBEDTLS_ASYMMETRIC_CONTENT_LEN=y

# Override some defaults so BT stack is enabled and
CONFIG_BT_ENABLED=y
CONFIG_BTDM_CTRL_MODE_BLE_ONLY=y
CONFIG_BTDM_CTRL_MODE_BR_EDR_ONLY=n
CONFIG_BTDM_CTRL_MODE_BTDM=n
CONFIG_BT_NIMBLE_ENABLED=y

## For Bluedroid as binary is larger than default size
CONFIG_PARTITION_TABLE_CUSTOM=y
CONFIG_PARTITION_TABLE_CUSTOM_FILENAME="partitions.csv"
CONFIG_PARTITION_TABLE_FILENAME="partitions.csv"


CONFIG_NEWLIB_ENABLE=y
CONFIG_NEWLIB_LIBRARY_LEVEL_NORMAL=y
CONFIG_NEWLIB_NANO_FORMAT=
CONFIG_SSL_USING_MBEDTLS=y
CONFIG_LWIP_IPV6=n
CONFIG_MBEDTLS_THREADING_C=y
CONFIG_MBEDTLS_THREADING_ALT=n
CONFIG_MBEDTLS_THREADING_PTHREAD=y
#CONFIG_PTHREAD_TASK_STACK_SIZE_DEFAULT=8192
#CONFIG_PARTITION_TABLE_CUSTOM=y
#CONFIG_PARTITION_TABLE_CUSTOM_FILENAME="partitions_ota_mqtt.csv"
#CONFIG_PARTITION_TABLE_FILENAME="partitions_ota_mqtt.csv"
CONFIG_ESPTOOLPY_FLASHSIZE_4MB=y
CONFIG_BOOTLOADER_APP_ROLLBACK_ENABLE=y
```

## test/main/Kconfig.projbuild
```kconfig
menu "Example Configuration"
    config AWS_IOT_THING_NAME
        string "AWS IoT Thing Name"
        default "VSESP"
        help
            AWS IoT Thing Name

    config AWS_IOT_CLIENT_ID
        string "AWS IoT Client ID"
        default "ESP32-CLIENT"
        help
            AWS IoT Client Name


    config WIFI_SSID
        string "ESP WiFi SSID"
        default "Silver Apple"
        help
            SSID (network name) for the example to connect to.

    config WIFI_PASSWORD
        string "WiFi Password"
        default "9257366678"
        help
            WiFi password (WPA or WPA2) for the example to use.

            Can be left blank if the network has no security set.

    config AWS_EXAMPLE_CLIENT_ID
        string "AWS IoT Client ID"
        default "myesp32"
        help
            AWS IoT Client ID for the example. Should be unique for every device.

    choice EXAMPLE_CERT_SOURCE
        prompt "AWS IoT Certificate Source"
        default EXAMPLE_EMBEDDED_CERTS
        help
            AWS IoT requires loading of a device-specific certificate and private key,
            and a common Root CA Certificate. These can be compiled into the example
            app, or they can be loaded via the filesystem from an SD card.

        config EXAMPLE_EMBEDDED_CERTS
            bool "Embed into app"
        config EXAMPLE_SDCARD_CERTS
            bool "Load from SD card"
            select EXAMPLE_FILESYSTEM_CERTS
    endchoice

    # Currently this is equivalent to EXAMPLE_SDCARD_CERTS,
    # however eventually we want to support more filesystem
    # sources (SPIFFS, etc.) So this hidden config item
    # is selected whenever the item should load from filesystem.
    config EXAMPLE_FILESYSTEM_CERTS
        bool

    config EXAMPLE_CERTIFICATE_PATH
        string "Device Certificate Path"
        depends on EXAMPLE_FILESYSTEM_CERTS
        default "/sdcard/certificate.pem.crt"

    config EXAMPLE_PRIVATE_KEY_PATH
        string "Device Private Key Path"
        depends on EXAMPLE_FILESYSTEM_CERTS
        default "/sdcard/private.pem.key"

    config EXAMPLE_ROOT_CA_PATH
        string "Root CA Certificate Path"
        depends on EXAMPLE_FILESYSTEM_CERTS
        default "/sdcard/aws-root-ca.pem"
    choice EXAMPLE_PROV_TRANSPORT
        bool "Provisioning Transport"
        default EXAMPLE_PROV_TRANSPORT_SOFTAP if IDF_TARGET_ESP32S2
        default EXAMPLE_PROV_TRANSPORT_BLE
        help
            Wi-Fi provisioning component offers both, SoftAP and BLE transports. Choose any one.
    
        config EXAMPLE_PROV_TRANSPORT_BLE
            bool "BLE"
            select BT_ENABLED
            depends on !IDF_TARGET_ESP32S2
        config EXAMPLE_PROV_TRANSPORT_SOFTAP
            bool "Soft AP"
    endchoice
    
    config EXAMPLE_PROV_TRANSPORT
        int
        default 1 if EXAMPLE_PROV_TRANSPORT_BLE
        default 2 if EXAMPLE_PROV_TRANSPORT_SOFTAP
    
    config EXAMPLE_PROV_SHOW_QR
        bool "Show provisioning QR code"
        default y
        help
            Show the QR code for provisioning.
 #######################################
    config MQTT_CLIENT_IDENTIFIER
        string "The MQTT client identifier used in this example"
	    default "VSESP"
	    help
            The MQTT client identifier used in this example. Each client identifier must be unique.
            so edit as required to ensure that no two clients connecting to the same broker use the same client identifier.

    config MQTT_BROKER_ENDPOINT
        string "Endpoint of the MQTT broker to connect to"
        default "aydkrv4pzznq4-ats.iot.us-east-1.amazonaws.com"
        help
            This example can be run with any MQTT broker, that supports server authentication.

    config MQTT_BROKER_PORT
        int "Port of the MQTT broker use"
        default 8883
        help
            In general, port 8883 is for secured MQTT connections.
            Port 443 requires use of the ALPN TLS extension with the ALPN protocol name.
            When using port 8883, ALPN is not required.

    config MQTT_OPTION_SNI
        int "An option to disable Server Name Indication"
        range 0 1
        default 0
        help
            When using a local Mosquitto server setup, SNI needs to be disabled
            for an MQTT broker that only has an IP address but no hostname. However,
            SNI should be enabled whenever possible.

    config HARDWARE_PLATFORM_NAME
        string "The hardware platform"
        default "ESP32"
        help
            The name of the hardware platform the application is running on.

    config MQTT_EXAMPLE_STACKSIZE
        int "Set the stack size of the example task"
        range 5120 8192
        default 5120
        help
            The actual stack is created by an operating system thread.

    config MQTT_NETWORK_BUFFER_SIZE
        int "Size of the network buffer for MQTT packets"
        range 1024 2048
        default 1024
        help
            Size of the network buffer for MQTT packets.   

endmenu
```
